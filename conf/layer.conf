## conf/layer.conf
```bitbake
# We have a conf and classes directory, add to BBPATH
BBPATH .= ":${LAYERDIR}"

# We have recipes-* directories, add to BBFILES
BBFILES += "${LAYERDIR}/recipes-*/*/*.bb \
            ${LAYERDIR}/recipes-*/*/*.bbappend"

BBFILE_COLLECTIONS += "../sources/meta-ecockpit"
BBFILE_PATTERN_../sources/meta-ecockpit = "^${LAYERDIR}/"
BBFILE_PRIORITY_../sources/meta-ecockpit = "9"
```

## conf/machine/imx8qmmekecockpit.conf
```bitbake
require conf/machine/imx8qmmek.conf

MACHINE_FEATURES_append = " optee"
MACHINE_FEATURES_remove = "qca6174"

KERNEL_DEVICETREE = "freescale/imx8qm-mek-a53.dtb"
KERNEL_DEVICETREE += "freescale/imx8qm-mek-a72.dtb"

UBOOT_CONFIG[sd] = "imx8qm_mek_a53_defconfig"
IMX_BOOT_SEEK = "32"
```
